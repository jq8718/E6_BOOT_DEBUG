## main/Kconfig.projbuild
```kconfig
menu "USB to I2C Bridge Configuration"

    config I2C_SDA_GPIO
        int "I2C SDA GPIO number"
        default 7
        range 0 54
        help
            GPIO number for I2C SDA signal.
            ESP32-P4 default: GPIO7

    config I2C_SCL_GPIO
        int "I2C SCL GPIO number"
        default 8
        range 0 54
        help
            GPIO number for I2C SCL signal.
            ESP32-P4 default: GPIO8

    config I2C_MASTER_FREQ_HZ
        int "I2C master clock frequency (Hz)"
        default 100000
        range 10000 400000
        help
            I2C bus clock frequency in Hz.
            Standard mode: 100000 (100 kHz)
            Fast mode: 400000 (400 kHz)

endmenu
```

## sdkconfig.defaults
```kconfig
# ESP32-P4 USB to I2C Bridge
CONFIG_IDF_TARGET_ESP32P4=y

# Flash 16MB
CONFIG_ESPTOOLPY_FLASHSIZE_16MB=y
CONFIG_ESPTOOLPY_FLASHMODE_DIO=y
CONFIG_ESPTOOLPY_FLASHFREQ_80M=y

# Partition
CONFIG_PARTITION_TABLE_CUSTOM=y
CONFIG_PARTITION_TABLE_CUSTOM_FILENAME="partitions_16MB.csv"
CONFIG_PARTITION_TABLE_FILENAME="partitions_16MB.csv"

# PSRAM 4MB
CONFIG_SPIRAM=y
CONFIG_SPIRAM_MODE_HEX=y
CONFIG_SPIRAM_SPEED_20M=y
CONFIG_SPIRAM_USE_MALLOC=y

# TinyUSB CDC
CONFIG_TINYUSB_CDC_ENABLED=y
CONFIG_TINYUSB_CDC_RX_BUFSIZE=512
CONFIG_TINYUSB_CDC_TX_BUFSIZE=512
CONFIG_TINYUSB_RHPORT_HS=y
CONFIG_TINYUSB_MODE_DMA=y
CONFIG_TINYUSB_TASK_STACK_SIZE=8192

# Console via USB Serial/JTAG
CONFIG_ESP_CONSOLE_USB_SERIAL_JTAG=y

# FreeRTOS
CONFIG_FREERTOS_HZ=1000
```
